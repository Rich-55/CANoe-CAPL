/*@!Encoding:1252*/
variables
{
  message 0x2E3 msgEcho;
  message 0x2E4 msgSum;
}

on message 0x3B2
{
  int i;
  int sum;
  word engineSpeed;
  sum = 0;
  
  engineSpeed = ((this.byte(0) & 0x0F) << 12)
              | (this.byte(1) << 4)
              | ((this.byte(2) & 0xF0) >> 4); //((this.byte(2) >> 4) & 0x0F); 

  for (i = 0; i < 3; i++) //8
  {
   msgEcho.byte(i) = this.byte(i);
 }
  
  
  msgEcho.dlc = 3;
  output(msgEcho);
  
  write("Node2 sent 0x2E3: Echoed 0x3B2 with EngineSpeed = %x", engineSpeed); //%d

  for (i = 0; i < 3; i++)
  {
    sum += this.byte(i);
  }

//  for (i = 0; i < 8; i++)
//  {
//    msgSum.byte(i) = 0;
//  }

//  msgSum.byte(0) = sum & 0xFFF;

//  output(msgSum);
  write("Node2 Sent 0x2E4: Byte Sum = %d", sum);
//  sum = 0;
}
