/*@!Encoding:65001*/
/* ECU1 with CAN ID 0x123 */

includes
{
  #include "CANTP.can"
}

variables {
  byte data_package[4095];
  int data_length;
  byte received_data[4095];
  int cf_received = 0;
}

on start {
  CanTp_SetTimeout(CANTP_COUNTER_AS, 1000);
  CanTp_SetTimeout(CANTP_COUNTER_AR, 1000);
  CanTp_SetTimeout(CANTP_COUNTER_BS, 1000);
  CanTp_SetTimeout(CANTP_COUNTER_BR, 1000);
  CanTp_SetTimeout(CANTP_COUNTER_CS, 1000);
  CanTp_SetTimeout(CANTP_COUNTER_CR, 1000);
  rx_can_id = 0x456;
  
  // Test: Send 4 bytes (Single Frame)
  tx_length = 4;
  for (i = 0; i < tx_length; i++) {
    tx_data[i] = i + 1;
  }
  write("ECU1 sending %d bytes", tx_length);
  CanTp_Transmit(0x123, tx_data, tx_length);
}

on message 0x456 {
  byte pci;
  int frame_type, sn;
  pci = this.byte(0);
  frame_type = (pci & 0xF0) >> 4;

  if (frame_type == 1) { /* FF */
    rx_expected_length = ((pci & 0x0F) << 8) | this.byte(1);
    rx_length = 0;
    for (i = 0; i < 6; i++) {
      rx_data[rx_length + i] = this.byte(i + 2);
    }
    rx_length = 6;
    sequence_number = 0;
    cf_received = 0;
    write("ECU1 Received FF: Expected Length=%d", rx_expected_length);
    SendFlowControl();
  } else if (frame_type == 2) { /* CF */
    sn = pci & 0x0F;
    if (sn == (sequence_number + 1) % 16) {
      sequence_number = sn;
      for (i = 0; i < 7 && rx_length < rx_expected_length; i++) {
        rx_data[rx_length] = this.byte(i + 1);
        rx_length++;
      }
      cf_received++;
      write("ECU1 Received CF: SN=%d, Total Length=%d", sn, rx_length);
      if (rx_length >= rx_expected_length) {
        write("ECU1 Message Complete: Received %d bytes", rx_length);
        CanTp_ReceiveIndication(this.id, rx_data, rx_length);
        rx_length = 0;
        rx_expected_length = 0;
        sequence_number = 0;
        cf_received = 0;
      } else if (cf_received >= 2) {
        SendFlowControl();
        cf_received = 0;
      }
    } else {
      write("ECU1 Invalid CF SN: Expected %d, Received %d", (sequence_number + 1) % 16, sn);
    }
  }
}

SendFlowControl() {
  message 0x123 fc_msg;
  fc_msg.dlc = 8;
  fc_msg.byte(0) = 0x30;
  fc_msg.byte(1) = 2;
  fc_msg.byte(2) = 10;
  for (i = 3; i < 8; i++) {
    fc_msg.byte(i) = 0x55;
  }
  output(fc_msg);
  write("ECU1 Sent FC: FS=CTS, BS=2, STmin=10ms");
}